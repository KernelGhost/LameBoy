#include <Arduino.h>
#include <U8g2lib.h>
#include <SPI.h>
#include <Wire.h>
#include <avr/pgmspace.h>

// Define pin for buzzer
#define BUZZER_PIN 12

// Define pins for LCD Display ([E, Clock --> 13], [RW, Data, MOSI --> 11], [RS, Chip Select --> 10], [RST, Reset --> 8])
#define CLOCK_PIN 13
#define DATA_PIN 11
#define CHIP_SELECT_PIN 10
#define RESET_PIN 8

// Define pins for buttons [A, UP, LEFT, RIGHT, DOWN]
const byte byteButtonPins[] PROGMEM = {20, 22, 24, 26, 28};

// Define timer speed
#define TIMER_SPEED 60        // Clock speed of sound and delay timers (Hertz)

// Define display width and height
#define SCREEN_WIDTH 64
#define SCREEN_HEIGHT 32

// Set Up LCD Display (ST7920 128x64 LCD Display)
U8G2_ST7920_128X64_F_SW_SPI u8g2(U8G2_R0, CLOCK_PIN, DATA_PIN, CHIP_SELECT_PIN, RESET_PIN);

// MODELLING CPU & SYSTEM MEMORY
byte system_memory[4096];     // RAM (4KB) --> [0x000-0x1FF - Chip 8 interpreter], [0x050-0x0A0 - Used for the built in 4x5 pixel font set (0-F)], [0x200-0xFFF - Program ROM and work RAM]
short operation_code;         // Current Operation Code
byte V_Reg[16];               // General Purpose Registers
short Index_Reg;              // Index Register
short program_counter;        // Program Counter
short system_stack[16];       // Stack
short stack_pointer;          // Stack Pointer
boolean boolDraw;             // Redraw Screen
boolean boolSystemOK;         // Set to false on fatal error

// MODELLING TIMERS
unsigned long delayStart;     // Used to keep timer at set frequency (delta checks)
uint16_t delay_timer;         // Stores the state of the delay timer
uint16_t sound_timer;         // Stores the state of the sound timer

// MODELLING KEYS
boolean boolKeys[16];         // Although all 16 inputs are modelled, included ROMs only use keys 0-4 inclusive [Mapped to A, UP, LEFT, RIGHT & DOWN respectively in included ROMs]

// GRAPHICS RELATED VARIABLES
// Holds display state
boolean graphics[SCREEN_WIDTH * SCREEN_HEIGHT];

// Used to update display
byte byteNewPixel;
uint16_t intGraphicsLocation;

// COUNTERS
byte byteCtr1 = 0;
byte byteCtr2 = 0;
short shortCtr = 0;
uint16_t intCtr = 0;

// SPLASH AND ERROR SCREENS
// Splash Screen (128x64)
static const unsigned char SplashScreen[] PROGMEM = {
  0x00, 0x00, 0x00, 0x00, 0x00, 0x00, 0x00, 0x00, 0x00, 0x00, 0x00, 0x00, 0x00, 0x00, 0x00, 0x00, 
  0x00, 0x00, 0x00, 0x00, 0x00, 0x00, 0x00, 0x00, 0x00, 0x00, 0x00, 0x00, 0x00, 0x00, 0x00, 0x00, 
  0x00, 0x00, 0x00, 0x00, 0x00, 0x00, 0x00, 0x00, 0x00, 0x00, 0x00, 0x00, 0x00, 0x00, 0x00, 0x00, 
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  0x00, 0x00, 0x00, 0x00, 0x00, 0x00, 0x00, 0x00, 0x00, 0x00, 0x00, 0x00, 0x00, 0x00, 0x00, 0x00
};

// Error Screen (128x64)
static const unsigned char ErrorScreen[] PROGMEM = {
  0x00, 0x00, 0x00, 0x00, 0x00, 0x00, 0x00, 0x00, 0x00, 0x00, 0x00, 0x00, 0x00, 0x00, 0x00, 0x00,
  0x00, 0x00, 0x00, 0x00, 0x00, 0x00, 0x00, 0x00, 0x00, 0x00, 0x00, 0x00, 0x00, 0x00, 0x00, 0x00,
  0x00, 0x00, 0x00, 0x00, 0x00, 0x00, 0x00, 0x00, 0x00, 0x00, 0x00, 0x00, 0x00, 0x00, 0x00, 0x00,
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  0x00, 0x00, 0x00, 0x00, 0x00, 0x00, 0x00, 0x00, 0x00, 0x00, 0x00, 0x00, 0x00, 0x00, 0x00, 0x00
};

// ROMS
/*  There are a total of 8 ROMs on the system, and each 'page' on the menu can display 5 ROMs.
 *  Hence we have 4 pages [0, 1, 2, 3, 4], [1, 2, 3, 4, 5], [2, 3, 4, 5, 6] & [3, 4, 5, 6, 7].
 *  Within each page, the user can select one of the 5 displayed ROM names. The 'page' and
 *  'index' can then be converted into the final selected ROM number by summation when the
 *  selection to play a ROM is finally made by pressing the A button.
 */
byte byteSelectedROMPage = 0;
byte byteSelectedROMIndex = 0;

// Rom Struct
struct ROM {
  const byte *romPtr;       // Pointer to the ROM in flash memory
  uint16_t numElements;     // Stores the size of the ROM
};

/* INCLUDED ROMS
 * 0 = Blinky (Pac-Man)
 * 1 = Tetris
 * 2 = Brick
 * 3 = Snake
 * 4 = Space Invaders
 * 5 = Hidden
 * 6 = Pong (Single Player)
 * 7 = Kaleidoscope
 */

const char ROM_0[] PROGMEM = "1) Blinky";
const char ROM_1[] PROGMEM = "2) Tetris";
const char ROM_2[] PROGMEM = "3) Brick";
const char ROM_3[] PROGMEM = "4) Snake";
const char ROM_4[] PROGMEM = "5) Invaders";
const char ROM_5[] PROGMEM = "6) Hidden";
const char ROM_6[] PROGMEM = "7) Pong";
const char ROM_7[] PROGMEM = "8) Scope";

const char * const ROM_table[] PROGMEM = {ROM_0, ROM_1, ROM_2, ROM_3, ROM_4, ROM_5, ROM_6, ROM_7};

// 0) Blinky (Pac-Man)
const byte byteROMBlinky[] PROGMEM = {
  (byte) 0x12, (byte) 0x1A, (byte) 0x32, (byte) 0x2E, (byte) 0x30, (byte) 0x30, (byte) 0x20, (byte) 0x43,
  (byte) 0x2E, (byte) 0x20, (byte) 0x45, (byte) 0x67, (byte) 0x65, (byte) 0x62, (byte) 0x65, (byte) 0x72,
  (byte) 0x67, (byte) 0x20, (byte) 0x31, (byte) 0x38, (byte) 0x2F, (byte) 0x38, (byte) 0x2D, (byte) 0x27,
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  (byte) 0x78, (byte) 0x00, (byte) 0x10, (byte) 0xE0
};

// 1) Tetris
const byte byteROMTetris[] PROGMEM = {
  (byte) 0xA2, (byte) 0xB4, (byte) 0x23, (byte) 0xE6, (byte) 0x22, (byte) 0xB6, (byte) 0x70, (byte) 0x01,
  (byte) 0xD0, (byte) 0x11, (byte) 0x30, (byte) 0x25, (byte) 0x12, (byte) 0x06, (byte) 0x71, (byte) 0xFF,
  (byte) 0xD0, (byte) 0x11, (byte) 0x60, (byte) 0x1A, (byte) 0xD0, (byte) 0x11, (byte) 0x60, (byte) 0x25,
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  (byte) 0x60, (byte) 0x19, (byte) 0x00, (byte) 0xEE, (byte) 0x37, (byte) 0x23
};

// 2) Brick
const byte byteROMBrick[] PROGMEM = {
  (byte) 0x6E, (byte) 0x05, (byte) 0x65, (byte) 0x00, (byte) 0x6B, (byte) 0x06, (byte) 0x6A, (byte) 0x00,
  (byte) 0xA3, (byte) 0x0C, (byte) 0xDA, (byte) 0xB1, (byte) 0x7A, (byte) 0x04, (byte) 0x3A, (byte) 0x40,
  (byte) 0x12, (byte) 0x08, (byte) 0x7B, (byte) 0x01, (byte) 0x3B, (byte) 0x12, (byte) 0x12, (byte) 0x06,
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  (byte) 0x6E, (byte) 0x05, (byte) 0x00, (byte) 0xE0, (byte) 0x12, (byte) 0x04
};

// 3) Snake
const byte byteROMSnake[] PROGMEM = {
  (byte) 0x12, (byte) 0x28, (byte) 0xCD, (byte) 0x3F, (byte) 0xCE, (byte) 0x1F, (byte) 0xA0, (byte) 0x89,
  (byte) 0xDD, (byte) 0xE1, (byte) 0x3F, (byte) 0x01, (byte) 0x00, (byte) 0xEE, (byte) 0xDD, (byte) 0xE1,
  (byte) 0x12, (byte) 0x02, (byte) 0xA8, (byte) 0x01, (byte) 0x61, (byte) 0x01, (byte) 0xF0, (byte) 0x65,
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  (byte) 0x12, (byte) 0xB0
};

// 4) Space Invaders
const byte byteROMSpaceInvaders[] PROGMEM = {
  (byte) 0x12, (byte) 0x25, (byte) 0x53, (byte) 0x50, (byte) 0x41, (byte) 0x43, (byte) 0x45, (byte) 0x20,
  (byte) 0x49, (byte) 0x4E, (byte) 0x56, (byte) 0x41, (byte) 0x44, (byte) 0x45, (byte) 0x52, (byte) 0x53,
  (byte) 0x20, (byte) 0x30, (byte) 0x2E, (byte) 0x39, (byte) 0x31, (byte) 0x20, (byte) 0x42, (byte) 0x79,
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  (byte) 0x00, (byte) 0x00, (byte) 0x00, (byte) 0x00, (byte) 0x00
};

// 5) Hidden
const byte byteROMHidden[] PROGMEM = {
  (byte) 0x12, (byte) 0x1D, (byte) 0x48, (byte) 0x49, (byte) 0x44, (byte) 0x44, (byte) 0x45, (byte) 0x4E,
  (byte) 0x21, (byte) 0x20, (byte) 0x31, (byte) 0x2E, (byte) 0x30, (byte) 0x20, (byte) 0x42, (byte) 0x79,
  (byte) 0x20, (byte) 0x44, (byte) 0x61, (byte) 0x76, (byte) 0x69, (byte) 0x64, (byte) 0x20, (byte) 0x57,
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  (byte) 0x01, (byte) 0xFF
};

// 6) Pong (Single Player)
const byte byteROMPong[] PROGMEM = {
  (byte) 0x6A, (byte) 0x02, (byte) 0x6B, (byte) 0x0C, (byte) 0x6C, (byte) 0x3F, (byte) 0x6D, (byte) 0x0C,
  (byte) 0xA2, (byte) 0xEA, (byte) 0xDA, (byte) 0xB6, (byte) 0xDC, (byte) 0xD6, (byte) 0x6E, (byte) 0x00,
  (byte) 0x22, (byte) 0xD4, (byte) 0x66, (byte) 0x03, (byte) 0x68, (byte) 0x02, (byte) 0x60, (byte) 0x60,
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  (byte) 0x80, (byte) 0x00, (byte) 0x00, (byte) 0x00, (byte) 0x00, (byte) 0x00
};

// 7) Kaleidoscope
const byte byteROMKaleidoscope[] PROGMEM = {
  (byte) 0x60, (byte) 0x00, (byte) 0x63, (byte) 0x80, (byte) 0x61, (byte) 0x1F, (byte) 0x62, (byte) 0x0F,
  (byte) 0x22, (byte) 0x32, (byte) 0xA2, (byte) 0x00, (byte) 0xF3, (byte) 0x1E, (byte) 0xF0, (byte) 0x0A,
  (byte) 0xF0, (byte) 0x55, (byte) 0x40, (byte) 0x00, (byte) 0x12, (byte) 0x1C, (byte) 0x73, (byte) 0x01,
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  (byte) 0x00, (byte) 0x00
};

// Store ROM Pointers and sizes
const ROM ROMs[] = {
  {byteROMBlinky, sizeof(byteROMBlinky)},
  {byteROMTetris, sizeof(byteROMTetris)},
  {byteROMBrick, sizeof(byteROMBrick)},
  {byteROMSnake, sizeof(byteROMSnake)},
  {byteROMSpaceInvaders, sizeof(byteROMSpaceInvaders)},
  {byteROMHidden, sizeof(byteROMHidden)},
  {byteROMPong, sizeof(byteROMPong)},
  {byteROMKaleidoscope, sizeof(byteROMKaleidoscope)}
};

// FONTSET (STORED FROM 0x050 TO 0x0A0 IN SYSTEM MEMORY)
const byte fontset[] PROGMEM = {
  (byte) 0xF0, (byte) 0x90, (byte) 0x90, (byte) 0x90, (byte) 0xF0, //0
  (byte) 0x20, (byte) 0x60, (byte) 0x20, (byte) 0x20, (byte) 0x70, //1
  (byte) 0xF0, (byte) 0x10, (byte) 0xF0, (byte) 0x80, (byte) 0xF0, //2
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  (byte) 0xF0, (byte) 0x80, (byte) 0xF0, (byte) 0x80, (byte) 0x80  //F
};

void setup() {
  // INITIALISE LCD DISPLAY
  u8g2.begin();
  u8g2.clearBuffer();
  
  // INITIALISE BUTTON PINS
  for (byteCtr1 = 0; byteCtr1 < sizeof(byteButtonPins); byteCtr1++) {
    pinMode(pgm_read_byte(&byteButtonPins[byteCtr1]), INPUT_PULLUP);
  }

  // DISPLAY BOOTSCREEN
  BootScreen();

  // GET SELECTED ROM
  MainMenu();

  // SET INITIAL GOOD SYSTEM STATE
  boolSystemOK = true;
  
  // INITIALISE SPECIAL
  program_counter = 0x200;
  operation_code = 0x0000;
  Index_Reg = 0x0000;
  stack_pointer = 0x0000;
  
  // INITIALISE GRAPHICS
  for (shortCtr = 0; shortCtr < sizeof(graphics); shortCtr++) {
    graphics[shortCtr] = false;
  }
  
  // INITIALISE REGISTERS, KEYS AND STACK
  for (byteCtr1 = 0; byteCtr1 < sizeof(V_Reg); byteCtr1++) {
    V_Reg[byteCtr1] = 0x00;
    boolKeys[byteCtr1] = false;
    system_stack[byteCtr1] = 0x0000;
  }
  
  // INITIALISE SYSTEM MEMORY
  for (shortCtr = 0; shortCtr < sizeof(system_memory); shortCtr++) {
    system_memory[shortCtr] = 0x00;
  }
  
  // INITIALISE TIMERS
  delay_timer = 0;
  sound_timer = 0;
  
  // INITIALISE FLAGS
  boolDraw = false;
  
  // LOAD FONTSET INTO SYSTEM MEMORY
  for (byteCtr1 = 0; byteCtr1 < sizeof(fontset); byteCtr1++) {
    system_memory[byteCtr1 + 0x0A0] = pgm_read_byte(&fontset[byteCtr1]);
  }
  
  // LOAD SELECTED ROM INTO SYSTEM MEMORY
  for (intCtr = 0; intCtr < ROMs[byteSelectedROMPage + byteSelectedROMIndex].numElements; intCtr++) {
    system_memory[0x200 + intCtr] = pgm_read_byte(&ROMs[byteSelectedROMPage + byteSelectedROMIndex].romPtr[intCtr]);
  }
  
  // NOTE START TIME
  delayStart = millis();
}

void BootScreen() {
  // Display Splash Screen
  u8g2.drawXBMP(0, 0, 128, 64, SplashScreen);
  u8g2.sendBuffer();
  u8g2.clearBuffer();
  
  // Play Boot Chime
  delay(500);
  tone(BUZZER_PIN, 932, 136);
  delay(136);
  tone(BUZZER_PIN, 932, 136);
  delay(136);
  tone(BUZZER_PIN, 416, 136);
  delay(136);
  tone(BUZZER_PIN, 740, 272);
  delay(272);
  tone(BUZZER_PIN, 740, 136);
  delay(136);
  tone(BUZZER_PIN, 622, 272);
  delay(544);
  tone(BUZZER_PIN, 1865, 272);
  delay(272);
  tone(BUZZER_PIN, 1480, 272);
  delay(544);

  // Display the boot screen for just a little bit longer
  delay(250);
}

void MainMenu() {
  boolean boolSelectROM = false;    // Holds user on menu until a ROM is chosen

  // INITIALISE KEYS
  for (byteCtr1 = 0; byteCtr1 < sizeof(boolKeys); byteCtr1++) {
    boolKeys[byteCtr1] = false;
  }
  
  // DRAW MENU SCREEN
  // Draw Border
  u8g2.setDrawColor(1);
  u8g2.drawBox(0, 0, 128, 64);
  u8g2.setDrawColor(0);
  u8g2.drawBox(2, 2, 128 - 4, 64 - 4);
  
  // Draw Horizontal line
  u8g2.setDrawColor(1);
  u8g2.drawBox(2, 15, 128 - 4, 2);
  
  // Draw Scrollbar Outline
  u8g2.drawBox(4, 19, 6, 41);
  
  // Draw Title
  u8g2.setFont(u8g2_font_helvB10_tr);
  u8g2.drawStr((128 - u8g2.getStrWidth("Games Menu"))/2, 14, "Games Menu");
  
  // Draw Enter Graphic
  u8g2.setFont(u8g2_font_open_iconic_gui_4x_t);
  u8g2.drawStr(86, 57, "@");
  
  // Draw Game Names & Scrollbar
  UpdateMenu();
  u8g2.sendBuffer();

  // Prevent 'A' button press from boot screen being mistaken as ROM choice
  delay(100);
  
  // Wait for user selection
  while (!boolSelectROM) {
    // Get Button States
    GrabKeys();

    // UP
    if (boolKeys[1] == true) {
      // Play Tone
      tone(BUZZER_PIN, 1000, 100);
      
      // Update Page/Index
      if (UpdatePageIdx(true)) {
        // Update Menu Screen
        UpdateMenu();
      }
      
    // DOWN
    } else if (boolKeys[4] == true) {
      // Play Tone
      tone(BUZZER_PIN, 1000, 100);
      
      // Update Page/Index
      if (UpdatePageIdx(false)) {
        // Update Menu Screen
        UpdateMenu();
      }

    // A
    } else if (boolKeys[0] == true) {
      // Play Tone
      tone(BUZZER_PIN, 1000, 100);
      
      // Clear Screen
      u8g2.setDrawColor(0);
      u8g2.drawBox(0, 0, 128, 64);
      
      // Break Loop
      boolSelectROM = true;
    }
    
    // Update Screen
    u8g2.sendBuffer();
    
    // Delay to not move erratically through the menu
    delay(50);
  }
}

boolean UpdatePageIdx(boolean boolUp) {
  boolean boolChange = false;
  
  if (boolUp) {
    // Need to decrement
    if (byteSelectedROMPage + byteSelectedROMIndex != 0) {
      boolChange = true;
      
      if (byteSelectedROMIndex == 0) {
        // At top of screen, move back a page
        byteSelectedROMPage--;
      } else {
        // Not at top of screen, no need to change page
        byteSelectedROMIndex--;
      }
    }
  } else {
    // Need to increment
    if (byteSelectedROMPage + byteSelectedROMIndex != 7) {
      boolChange = true;
      
      if (byteSelectedROMIndex == 4) {
        // At bottom of screen, move forward a page
        byteSelectedROMPage++;
      } else {
        // Not at bottom of screen, no need to change page
        byteSelectedROMIndex++;
      }
    }
  }

  return boolChange;
}

void UpdateMenu() {
  u8g2.setFont(u8g2_font_5x7_tr);
  char buffer[11];

  // Remove Previous ROM Names
  u8g2.setDrawColor(0);
  u8g2.drawBox(11, 19, 60, 41);
  
  // Write ROM Names
  u8g2.setDrawColor(1);
  for (byteCtr1 = byteSelectedROMPage; byteCtr1 < (5 + byteSelectedROMPage); byteCtr1++) {
     strcpy_P(buffer, (char*)pgm_read_word(&(ROM_table[byteCtr1])));
     u8g2.drawStr(11, 27 + ((byteCtr1 - byteSelectedROMPage) * 8), buffer);
  }

  // Draw Highlight Box
  u8g2.drawBox(11, 20 + (byteSelectedROMIndex * 8), 60, 8);

  // Redraw Selected ROM Name
  u8g2.setDrawColor(0);
  strcpy_P(buffer, (char*)pgm_read_word(&(ROM_table[byteSelectedROMPage + byteSelectedROMIndex])));
  u8g2.drawStr(11, 27 + (byteSelectedROMIndex * 8), buffer);

  // Update Scrollbar
  // Clear old position
  u8g2.setDrawColor(0);
  u8g2.drawBox(5, 20, 4, 39);
  // Draw new position
  u8g2.setDrawColor(1);
  u8g2.drawBox(6, 21 + (7 * byteSelectedROMPage), 2, 16);
}

void NextOperationCode() {
  //Fetch Operation Code
  operation_code = (short) ((system_memory[program_counter] << 8) | system_memory[program_counter + 1]);
  
  //Run Operation Code
  switch(operation_code & 0xF000) {
    case 0x0000:
    {
      switch(operation_code) {
        case 0x00E0:
        {
        //0x00E0 --> CLEAR DISPLAY.
          for (shortCtr = 0; shortCtr < sizeof(graphics); shortCtr++) {
            graphics[shortCtr] = false;
          }

          u8g2.setDrawColor(0);
          u8g2.drawBox(0, 0, 128, 64);
          
          boolDraw = true;
          
          program_counter += 2;
          break;
        }
        case 0x00EE:
        {
        //0x00EE --> RETURN FROM SUBROUTINE.
          stack_pointer--;
          program_counter = system_stack[stack_pointer];
          
          program_counter += 2;
          break;
        }
        default:
        {
        //0x0NNN --> CALL RCA 1802 PROGRAM AT NNN (NOT IMPLEMENTED AS NOT REQUIRED FOR MOST ROMS).
        // Unsupported operation code
        FatalError();
        break;
        }
      }
      break;
    }
    case 0x1000:
    {
    //0x1NNN --> JUMP TO NNN.
      program_counter = (short) (operation_code & 0x0FFF);
      break;
    }
    case 0x2000:
    {
    //0x2NNN --> CALL SUBROUTINE AT NNN.
      system_stack[stack_pointer] = program_counter;
      stack_pointer++;
      program_counter = (short) (operation_code & 0x0FFF);
      break;
    }
    case 0x3000:
    {
    //0x3XNN --> SKIP NEXT INSTRUCTION IF VX == NN.
      if (V_Reg[(byte) ((operation_code & 0x0F00) >> 8)] == (byte) (operation_code & 0x00FF)) {
          program_counter += 2;
      }
      
      program_counter += 2;
      break;
    }
    case 0x4000:
    {
    //0x4XNN --> SKIP NEXT INSTRUCTION IF VX != NN.
      if (V_Reg[(byte) ((operation_code & 0x0F00) >> 8)] != (byte) (operation_code & 0x00FF)) {
          program_counter += 2;
      }
      
      program_counter += 2;
      break;
    }
    case 0x5000:
    {
    //0x5XY0 --> SKIP NEXT INSTRUCTION IF VX == VY.
      if (V_Reg[(byte) ((operation_code & 0x0F00) >> 8)] == V_Reg[(byte) ((operation_code & 0x00F0) >> 4)]) {
          program_counter += 2;
      }
      
      program_counter += 2;
      break;
    }
    case 0x6000:
    {
    //0x6XNN --> SET VX = NN.
      V_Reg[(byte) ((operation_code & 0x0F00) >> 8)] = (byte) (operation_code & 0x00FF);
      
      program_counter += 2;
      break;
    }
    case 0x7000:
    {
    //0x7XNN --> ADD NN TO VX (NO CHANGE TO CARRY FLAG).
      V_Reg[(byte) ((operation_code & 0x0F00) >> 8)] += (byte) (operation_code & 0x00FF);
      
      program_counter += 2;
      break;
    }
    case 0x8000:
    {
      switch (operation_code & 0x000F) {
        case 0x0000:
        {
        //0x8XY0 --> SET VX = VY.
          V_Reg[(byte) ((operation_code & 0x0F00) >> 8)] = V_Reg[(byte) ((operation_code & 0x00F0) >> 4)];
            
          program_counter += 2;
          break;
        }
        case 0x0001:
        {
        //0x8XY1 --> SET VX = (VX | VY).
          V_Reg[(byte) ((operation_code & 0x0F00) >> 8)] |= V_Reg[(byte) ((operation_code & 0x00F0) >> 4)];
            
          program_counter += 2;
          break;
        }
        case 0x0002:
        {
        //0x8XY2 --> SET VX = (VX & VY).
          V_Reg[(byte) ((operation_code & 0x0F00) >> 8)] &= V_Reg[(byte) ((operation_code & 0x00F0) >> 4)];
            
          program_counter += 2;
          break;
        }
        case 0x0003:
        {
        //0x8XY3 --> SET VX = (VX XOR VY).
          V_Reg[(byte) ((operation_code & 0x0F00) >> 8)] ^= V_Reg[(byte) ((operation_code & 0x00F0) >> 4)];
        
          program_counter += 2;
          break;
        }
        case 0x0004:
        {
        //0x8XY4 --> ADD VY TO VX (SET VF TO 1 IF CARRY).
          if (((int) V_Reg[(byte) ((operation_code & 0x0F00) >> 8)] + (int) V_Reg[(byte) ((operation_code & 0x00F0) >> 4)]) > 0xFF) {
            V_Reg[0xF] = 1;
          } else {
            V_Reg[0xF] = 0;
          }
          
          V_Reg[(byte) ((operation_code & 0x0F00) >> 8)] += V_Reg[(byte) ((operation_code & 0x00F0) >> 4)];
          
          program_counter += 2;
          break;
        }
        case 0x0005:
        {
        //0x8XY5 --> SUBTRACT VY FROM VX (SET VF TO 0 IF BORROW).
          if ((int) V_Reg[(byte) ((operation_code & 0x00F0) >> 4)] > (int) V_Reg[(byte) ((operation_code & 0x0F00) >> 8)]) {
            V_Reg[0xF] = 0;
          } else {
            V_Reg[0xF] = 1;
          }
          
          V_Reg[(byte) ((operation_code & 0x0F00) >> 8)] -= V_Reg[(byte) ((operation_code & 0x00F0) >> 4)];
          
          program_counter += 2;
          break;
        }
        case 0x0006:
        {
        //0x8XY6 --> STORE LEAST SIGNIFICANT BIT OF VX IN VF, THEN SHIFT VX RIGHT BY 1.
          V_Reg[0xF] = (byte) (V_Reg[(byte) ((operation_code & 0x0F00) >> 8)] & 0b00000001);
          V_Reg[(byte) ((operation_code & 0x0F00) >> 8)] = (byte) (V_Reg[(byte) ((operation_code & 0x0F00) >> 8)] >> 1);
          
          program_counter += 2;
          break;
        }
        case 0x0007:
        {
        //0x8XY7 --> SET VX TO VY - VX. VF IS 0 IF BORROW, 1 IF NO BORROW.
          if ((int) V_Reg[(byte) ((operation_code & 0x00F0) >> 4)] > (int) V_Reg[(byte) ((operation_code & 0x0F00) >> 8)]) {
            V_Reg[0xF] = 1;
          } else {
            V_Reg[0xF] = 0;
          }
          
          V_Reg[(byte) ((operation_code & 0x0F00) >> 8)] = (byte) (V_Reg[(byte) ((operation_code & 0x00F0) >> 4)] - V_Reg[(byte) ((operation_code & 0x0F00) >> 8)]);
          
          program_counter += 2;
          break;
        }
        case 0x000E:
        {
        //0x8XYE --> STORE MOST SIGNIFICANT BIT OF VX IN VF, THEN SHIFT VX LEFT BY 1.
          V_Reg[0xF] = (byte) (V_Reg[(byte) ((operation_code & 0x0F00) >> 8)] >> 7);
          V_Reg[(byte) ((operation_code & 0x0F00) >> 8)] = (byte) (V_Reg[(byte) ((operation_code & 0x0F00) >> 8)] << 1);
          
          program_counter += 2;
          break;
        }
        default:
        {
        // Unrecognised CPU operation code
        FatalError();
        break;
        }
      }
    break;
    }
    case 0x9000:
    {
    //0x9XY0 --> SKIP NEXT INSTRUCTION IF VX != VY.
        if (V_Reg[(byte) ((operation_code & 0x0F00) >> 8)] != V_Reg[(byte) ((operation_code & 0x00F0) >> 4)]) {
            program_counter += 2;
        }
        
        program_counter += 2;
        break;
    }
    case 0xA000:
    {
    //0xANNN --> SET I to NNN.
    Index_Reg = (short) (operation_code & 0x0FFF);
    
    program_counter += 2;
    break;
    }
    case 0xB000:
    {
    //0xBNNN --> JUMP TO ADDR NNN PLUS V0.
    program_counter = (short) ((operation_code & 0x0FFF) + (V_Reg[0] & 0xFF));
    break;
    }
    case 0xC000:
    {
    //0xCXNN --> SET VX TO BITWISE AND OF NN AND RANDOM INTEGER (0 TO 255).
      randomSeed(analogRead(0));
      V_Reg[(byte) ((operation_code & 0x0F00) >> 8)] = (byte) ((byte) random(256) & (byte) (operation_code & 0x00FF));
      
      program_counter += 2;
      break;
    }
    case 0xD000:
    {
    /* 0xDXYN --> DRAW SPRITE AT COORDINATE (VX, VY) WITH WIDTH 8 PIXELS AND HEIGHT OF N PIXELS.
     *            EACH ROW OF 8 PIXELS IS READ FROM MEMORY AT I, I+1, ETC. VF IS SET TO 1 IF ANY
     *            SCREEN PIXELS ARE FLIPPED FROM SET TO UNSET, AND SET TO 0 IF THEY ARE NOT.
     *            THE STATE OF EACH PIXEL IS SET USING A BITWISE XOR OPERATION.
     *
     *            SPRITE VALUE | EXISTING VALUE | NEW VALUE  (XOR TRUTH TABLE)
     *            _____________|________________|__________
     *                  0      |        0       |     0     (NO CHANGE --> NO NEED TO CODE FOR CASE, NO CHANGE OF VF)
     *                  0      |        1       |     1     (NO CHANGE --> NO NEED TO CODE FOR CASE, NO CHANGE OF VF)
     *                  1      |        0       |     1     (CHANGE    --> NEED TO CODE FOR CASE,    NO CHANGE OF VF)
     *                  1      |        1       |     0     (CHANGE    --> NEED TO CODE FOR CASE,    NEED TO CHANGE VF)
     *
     *            REMEMBER THAT VF IS ONLY SET TO 1 WHEN A PIXEL GOES FROM SET TO UNSET, NOT GOING FROM UNSET TO SET.
     */
      
      V_Reg[0xF] = 0;
      for (byteCtr1 = 0; byteCtr1 < (byte) (operation_code & 0x000F); byteCtr1++) { // For each row of pixels
          byteNewPixel = system_memory[Index_Reg + byteCtr1]; // Store the row of pixels
          for (byteCtr2 = 0; byteCtr2 < 8; byteCtr2++) { // For each pixel in row
              if ((byteNewPixel & (0b10000000 >> byteCtr2)) != 0) { // If pixel on
                intGraphicsLocation = (V_Reg[(operation_code & 0x0F00) >> 8] + byteCtr2) + ((V_Reg[(operation_code & 0x00F0) >> 4] + byteCtr1) * SCREEN_WIDTH);
                
                // Catch cases where painting outside the screen may occur.
                // e.g. A sprite of horizontal length 4 at position (60, 31)
                // would go outside the screen.
                if (intGraphicsLocation < sizeof(graphics)) {
                  if ((graphics[intGraphicsLocation]) == true) { // If pixel already on
                    V_Reg[0xF] = 1; // Set VF to 1
                  }
                  
                  graphics[intGraphicsLocation] = !graphics[intGraphicsLocation]; // Invert pixel on screen
                    
                  if (graphics[intGraphicsLocation]) {
                    u8g2.setDrawColor(1);
                  } else {
                    u8g2.setDrawColor(0);
                  }

                  u8g2.drawBox((V_Reg[(operation_code & 0x0F00) >> 8] + byteCtr2) * 2, (V_Reg[(operation_code & 0x00F0) >> 4] + byteCtr1) * 2, 2, 2);
                }
              }
          }
      }
      
      boolDraw = true;
      
      program_counter += 2;
      break;
    }
    case 0xE000:
    {
      switch (operation_code & 0x00FF) {
        case 0x009E:
        {
        //0xEX9E --> SKIP NEXT INSTRUCTION IF THE KEY WITHIN VX IS PRESSED.
          if(boolKeys[V_Reg[(byte) ((operation_code & 0x0F00) >> 8)]]) {
            program_counter += 2;
          }
          
          program_counter += 2;
          break;
        }
        case 0x00A1:
        {
        //0xEXA1 --> SKIP NEXT INSTRUCTION IF THE KEY WITHIN VX IS NOT PRESSED.
          if(!boolKeys[V_Reg[(byte) ((operation_code & 0x0F00) >> 8)]]) {
            program_counter += 2;
          }
          
          program_counter += 2;
          break;
        }
        default:
        {
          // Unrecognised CPU operation code
          FatalError();
          break;
        }
      }
    break;
    }
    case 0xF000:
    {
      switch (operation_code & 0x00FF) {
        case 0x0007:
        {
        //0xFX07 --> SET VX TO VALUE OF DELAY TIMER.
          V_Reg[(byte) ((operation_code & 0x0F00) >> 8)] = (byte) (delay_timer & 0xFF);
          
          program_counter += 2;
          break;
        }
        case 0x000A:
        {
        //0xFX0A --> WAIT FOR KEYPRESS, THEN STORE IN VX.
          for (byteCtr1 = 0; byteCtr1 < sizeof(boolKeys); byteCtr1++) {
            if (boolKeys[byteCtr1]) {
              V_Reg[(byte) ((operation_code & 0x0F00) >> 8)] = byteCtr1;
              program_counter += 2;
              break;
            }
          }
          
          // If no key is pressed, we don't change the program counter so the operation_code will be run again
          break;
        }
        case 0x0015:
        {
        //0xFX15 --> SET DELAY TIMER TO VX.
          delay_timer = (int) V_Reg[(byte) ((operation_code & 0x0F00) >> 8)];
          
          program_counter += 2;
          break;
        }
        case 0x0018:
        {
        //0xFX18 --> SET SOUND TIMER TO VX.
          sound_timer = (int) V_Reg[(byte) ((operation_code & 0x0F00) >> 8)];
          
          program_counter += 2;
          break;
        }
        case 0x001E:
        {
        //0xFX1E --> ADD VX TO I. IF I + VX > 0xFFF, SET VF TO 1 ELSE SET TO 0.
          if (Index_Reg + V_Reg[(byte) ((operation_code & 0x0F00) >> 8)] > 0x0FFF) {
            V_Reg[0xF] = 1;
          } else {
            V_Reg[0xF] = 0;
          }
          
          Index_Reg = (short) ((Index_Reg + V_Reg[(byte) ((operation_code & 0x0F00) >> 8)]) & 0x0FFF);
          
          program_counter += 2;
          break;
        }
        case 0x0029:
        {
        //0xFX29 --> SET I TO ADDR OF SPRITE FOR THE CHARACTER IN VX.
        /*
         * Characters are stored in memory from 0x0A0 to 0x0F0. Each character
         * is stored as a sequence of 5 bytes, however only the leading 4 bits
         * of these bytes contain any 1s - the trailing 4 bits are all zero.
         * This is because the characters used by the CHIP-8 are only 4*5 pixels
         * in resolution. When this operation code is run, VX stores a byte ranging
         * in value from 0 to 15 (representing each of the 16 possible characters).
         * This value must be translated to the memory location of the first byte
         * of the requested character.
         */
          
          Index_Reg = (short) (0x0A0 + (V_Reg[(byte) ((operation_code & 0x0F00) >> 8)] * 0x5));
          
          program_counter += 2;
          break;
        }
        case 0x0033:
        {
        //0xFX33 --> STORE DECIMAL REPRESENTATION OF VX SEQUENTIALLY AT I, I+1 & I+2.
          system_memory[Index_Reg] = (byte) ((int) V_Reg[(byte) ((operation_code & 0x0F00) >> 8)] / 100);              //HUNDREDS DIGIT
          system_memory[Index_Reg + 1] = (byte) (((int) V_Reg[(byte) ((operation_code & 0x0F00) >> 8)] / 10) % 10);    //TENS DIGIT
          system_memory[Index_Reg + 2] = (byte) ((int) V_Reg[(byte) ((operation_code & 0x0F00) >> 8)] % 10);           //ONES DIGIT
          
          program_counter += 2;
          break;
        }
        case 0x0055:
        {
        //0xFX55 --> STORES V0 to VX (INCLUSIVE) TO MEMORY AT I INCREMENTED BY 1 FOR EACH VALUE WRITTEN.
          for (byteCtr1 = 0; byteCtr1 <= (byte) ((operation_code & 0x0F00) >> 8); byteCtr1++) {
            system_memory[Index_Reg + byteCtr1] = V_Reg[byteCtr1];
          }
          
          program_counter += 2;
          break;
        }
        case 0x0065:
        {
        //0xFX65 --> POPULATE V0 TO VX (INCLUSIVE) WITH MEMORY AT I INCREMENTED BY 1 FOR EACH VALUE WRITTEN.
          for (byteCtr1 = 0; byteCtr1 <= (byte) ((operation_code & 0x0F00) >> 8); byteCtr1++) {
            V_Reg[byteCtr1] = system_memory[Index_Reg + byteCtr1];
          }
          
          program_counter += 2;
          break;
        }
        default:
        {
          // Unrecognised CPU operation code
          FatalError();
          break;
        }
      }
    break;
    }
    default:
    {
      // Unrecognised CPU operation code
      FatalError();
      break;
    }
  }
}

void UpdateGraphics() {
  if (boolDraw) {
    u8g2.sendBuffer();
    boolDraw = false;
  }
}

void GrabKeys() {
  for (byteCtr1 = 0; byteCtr1 < sizeof(byteButtonPins); byteCtr1++) {
    boolKeys[byteCtr1] = (digitalRead(pgm_read_byte(&byteButtonPins[byteCtr1])) == HIGH);
  }
}

void UpdateTimers() {
  if (millis() - delayStart >= (int) (1000/TIMER_SPEED)) {
    // UPDATE DELAY TIMER
    if (delay_timer > 0) {
      delay_timer--;
    }
    
    // UPDATE SOUND TIMER
    if (sound_timer > 0) {
      tone(BUZZER_PIN, 1000, 100);
      sound_timer--;
    }
    
    // RESET START TIME
    delayStart = millis();
  }
}

void FatalError() {
  // Clear the screen
  u8g2.clearBuffer();
  
  // Display Error Screen
  u8g2.setDrawColor(1);
  u8g2.drawXBMP(0, 0, 128, 64, ErrorScreen);

  // Update Screen
  u8g2.sendBuffer();

  // Play Error Sound
  delay(100);
  tone(BUZZER_PIN, 466, 544);
  delay(544);
  tone(BUZZER_PIN, 440, 544);
  delay(544);
  tone(BUZZER_PIN, 415, 544);
  delay(544);
  tone(BUZZER_PIN, 392, 1088);
  delay(1088);

  // Stop Code Execution
  boolSystemOK = false;
}

void loop() {
  if (boolSystemOK) {
    GrabKeys();           // Detect buttons being pressed
    NextOperationCode();  // Perform next CPU cycle
    UpdateTimers();       // Decrement timers
    UpdateGraphics();     // Update the display
  }
}
